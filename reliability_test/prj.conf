## CMakeLists.txt
```
#
# nRF9151 reliability soak test — periodic CoAP heartbeats to a VPS.
#
# A small standalone app (not the full bring-up demo) that:
#   1. Attaches LTE-M once at boot
#   2. Every N minutes:
#      - samples telemetry (uptime, VBAT, RSRP, free heap, reset reason)
#      - CBOR-encodes a heartbeat payload
#      - POSTs it to a CoAP server via UDP
#      - returns the modem to PSM sleep between heartbeats
#   3. Re-establishes the connection if it drops
#
# Each device identifies itself via hwinfo_get_device_id() (8 bytes,
# durable per SoC) so the server can dashboard one row per board.
#
# SPDX-License-Identifier: Apache-2.0

cmake_minimum_required(VERSION 3.20.0)
find_package(Zephyr REQUIRED HINTS $ENV{ZEPHYR_BASE})
project(reliability_test)

target_sources(app PRIVATE
	src/main.c
	src/telemetry.c
	src/coap_client.c
)
```

## sysbuild.conf
```
# Single image, no MCUboot — matches the existing bring-up app's
# convention. We can add OTA / MCUboot later when production needs
# field updates.
SB_CONFIG_BOOTLOADER_MCUBOOT=n
```

## prj.conf
```kconfig
# =====================================================================
# Reliability test — periodic CoAP heartbeats over LTE-M
# =====================================================================

# --- Logging via RTT (no UART console on this board) ---------------
CONFIG_LOG=y
CONFIG_LOG_BUFFER_SIZE=4096
CONFIG_USE_SEGGER_RTT=y
CONFIG_RTT_CONSOLE=y
CONFIG_LOG_BACKEND_RTT=y
CONFIG_LOG_BACKEND_UART=n
CONFIG_UART_CONSOLE=n
CONFIG_CONSOLE=y
CONFIG_PRINTK=y

# Silence TF-M's secure-log UART (same as in nrf9151_bringup).
CONFIG_TFM_LOG_LEVEL_SILENCE=y

# --- The board's _ns_defconfig enables UART_0_ASYNC for sw-lpuart
# (the inter-MCU link in the bring-up firmware). This app doesn't
# use sw-lpuart, but board defaults can't be removed — so we just
# satisfy the dependency to silence the warnings. The actual async
# UART driver won't initialize anything because we don't reference it.
CONFIG_UART_ASYNC_API=y
CONFIG_NRFX_TIMER2=y

# --- Modem + LTE link control --------------------------------------
CONFIG_NRF_MODEM_LIB=y
CONFIG_LTE_LINK_CONTROL=y
CONFIG_LTE_NETWORK_MODE_LTE_M=y
# We don't set LTE_AUTO_INIT_AND_CONNECT — the default (n) is correct
# and we manage the lifecycle from main() ourselves.

# Enable PSM (Power Saving Mode) so the modem can sleep deep between
# heartbeats while keeping its LTE context. Requires the PSM module
# Kconfig to be on first.
CONFIG_LTE_LC_PSM_MODULE=y
CONFIG_LTE_PSM_REQ=y
CONFIG_LTE_PSM_REQ_RPTAU="00000110"   # T3412 = 6 * 30 min = 180 min
CONFIG_LTE_PSM_REQ_RAT="00000001"     # T3324 = 1 * 2 s = 2 s

# --- Networking / IP / sockets -------------------------------------
# The modem owns the IP stack via offload, so we DON'T enable
# NET_NATIVE. DNS resolution is done by the modem too — Zephyr's
# DNS_RESOLVER subsystem requires NET_NATIVE so we leave it off and
# use the offloaded getaddrinfo() in the socket layer.
CONFIG_NETWORKING=y
CONFIG_NET_SOCKETS=y
CONFIG_NET_SOCKETS_OFFLOAD=y
CONFIG_POSIX_API=y
CONFIG_NET_IPV4=y
CONFIG_NET_IPV6=n
CONFIG_NET_LOG=y

# --- CoAP client ---------------------------------------------------
# CONFIG_COAP=y is what we actually need (low-level packet API used
# by coap_client.c). COAP_CLIENT is a higher-level helper we don't
# use; left off to silence the experimental-symbol warning.
CONFIG_COAP=y

# --- GPIO (for red LED blink on heartbeat send) --------------------
CONFIG_GPIO=y

# --- PMIC for VBAT readings ----------------------------------------
CONFIG_I2C=y
CONFIG_SENSOR=y
CONFIG_REGULATOR=y
CONFIG_MFD=y
CONFIG_MFD_NPM1300=y
# Note: the charger Kconfig is CONFIG_NPM1300_CHARGER with no SENSOR_
# prefix — it lives at zephyr/drivers/sensor/nordic/npm1300_charger/Kconfig
CONFIG_NPM1300_CHARGER=y

# --- HWINFO for chip-ID identification -----------------------------
CONFIG_HWINFO=y

# --- CBOR encoder --------------------------------------------------
CONFIG_ZCBOR=y

# --- General Zephyr knobs ------------------------------------------
CONFIG_MAIN_STACK_SIZE=4096
CONFIG_HEAP_MEM_POOL_SIZE=8192
CONFIG_REBOOT=y

# --- Modem info for RSRP / RAT readouts ----------------------------
CONFIG_MODEM_INFO=y
CONFIG_MODEM_INFO_ADD_NETWORK=y
```

## src/main.c
```c
/*
 * Reliability test — periodic CoAP heartbeats over LTE-M.
 *
 * Flow:
 *   boot
 *     -> telemetry_init() + bump_boot_count()
 *     -> nrf_modem_lib_init()
 *     -> modem_info_init()
 *     -> lte_lc_connect()                  (LTE-M attach, ~5 s)
 *     -> coap_client_connect()             (UDP socket open, DNS resolve)
 *     -> loop forever:
 *           telemetry_collect()
 *           telemetry_encode_cbor()
 *           coap_client_post_heartbeat()
 *           on success: sleep COAP_HEARTBEAT_INTERVAL_S
 *           on failure: short retry, then reconnect from scratch
 *
 * The modem PSM settings in prj.conf let the modem deep-sleep between
 * heartbeats while keeping its EPS attachment, so wake-up cost is
 * single seconds instead of a full attach cycle.
 *
 * Failure modes handled (defensively, not exhaustively):
 *   - LTE link drop -> lte_lc reattach on next iteration
 *   - DNS / server unreachable -> reset socket, retry next interval
 *   - CoAP non-2.xx response -> retry next interval (no payload loss
 *     since we don't queue anything; v1 is best-effort)
 *
 * Things we intentionally DON'T do in v1:
 *   - Queue heartbeats while offline (NVS-backed queue would be v2)
 *   - DTLS-CID (v2, once the unencrypted loop is proven)
 *   - Adaptive cadence by signal strength (v2)
 *   - GNSS fix in the payload (v2 if useful)
 */

#include "telemetry.h"
#include "coap_client.h"
#include "server_config.h"

#include <zephyr/kernel.h>
#include <zephyr/logging/log.h>
#include <zephyr/sys/reboot.h>
#include <zephyr/drivers/gpio.h>

#include <modem/nrf_modem_lib.h>
#include <modem/lte_lc.h>
#include <modem/modem_info.h>

LOG_MODULE_REGISTER(main, LOG_LEVEL_INF);

#define MAX_PAYLOAD_BYTES   256
#define FAIL_BACKOFF_MS     30000   /* on send failure, retry sooner than the full interval */
#define LED_BLINK_MS        1000    /* red LED on for 1 s per heartbeat */

static volatile bool lte_connected;

/* --- Red LED blink on heartbeat send --------------------------------
 *
 * We use a delayable work-item so the LED-off happens asynchronously
 * without blocking the main loop's sendto/recv path. The LED stays
 * on for LED_BLINK_MS then turns itself off.
 *
 * If the heartbeat takes longer than LED_BLINK_MS to complete (e.g.
 * slow ACK), the LED just goes off as scheduled — that's fine, the
 * "I sent a packet" signal already fired. */
static const struct gpio_dt_spec led_red =
	GPIO_DT_SPEC_GET_OR(DT_ALIAS(led_red), gpios, {0});

static void led_off_work_fn(struct k_work *w);
static K_WORK_DELAYABLE_DEFINE(led_off_work, led_off_work_fn);

static void led_off_work_fn(struct k_work *w)
{
	(void)gpio_pin_set_dt(&led_red, 0);
}

static void led_blip(void)
{
	if (!led_red.port) {
		return;     /* DT didn't declare led-red alias */
	}
	(void)gpio_pin_set_dt(&led_red, 1);
	(void)k_work_reschedule(&led_off_work, K_MSEC(LED_BLINK_MS));
}

static void led_init(void)
{
	if (!led_red.port) {
		LOG_WRN("no led-red alias in DT; LED blink disabled");
		return;
	}
	if (!device_is_ready(led_red.port)) {
		LOG_WRN("led-red GPIO port not ready");
		return;
	}
	(void)gpio_pin_configure_dt(&led_red, GPIO_OUTPUT_INACTIVE);
}

static void lte_evt_handler(const struct lte_lc_evt *const evt)
{
	switch (evt->type) {
	case LTE_LC_EVT_NW_REG_STATUS:
		if (evt->nw_reg_status == LTE_LC_NW_REG_REGISTERED_HOME ||
		    evt->nw_reg_status == LTE_LC_NW_REG_REGISTERED_ROAMING) {
			lte_connected = true;
			LOG_INF("LTE registered (status=%d)", evt->nw_reg_status);
		} else {
			lte_connected = false;
			LOG_WRN("LTE NOT registered (status=%d)", evt->nw_reg_status);
		}
		break;
	case LTE_LC_EVT_PSM_UPDATE:
		LOG_INF("PSM update: TAU=%d s  Active=%d s",
			evt->psm_cfg.tau, evt->psm_cfg.active_time);
		break;
	case LTE_LC_EVT_RRC_UPDATE:
		LOG_INF("RRC mode: %s",
			evt->rrc_mode == LTE_LC_RRC_MODE_CONNECTED ?
			"connected" : "idle");
		break;
	default:
		break;
	}
}

static int wait_for_lte(int timeout_s)
{
	for (int i = 0; i < timeout_s; i++) {
		if (lte_connected) {
			return 0;
		}
		k_msleep(1000);
	}
	return -ETIMEDOUT;
}

int main(void)
{
	int err;

	LOG_INF("==========================================");
	LOG_INF("RELIABILITY TEST — periodic CoAP heartbeats");
	LOG_INF("  server: %s:%d  path=/%s  interval=%d s",
		COAP_SERVER_HOST, COAP_SERVER_PORT,
		COAP_HEARTBEAT_PATH, COAP_HEARTBEAT_INTERVAL_S);
	LOG_INF("==========================================");

	/* --- LED init (red blinks for 1 s on every successful send) --- */
	led_init();

	/* --- Telemetry init (chip ID + reset reason + boot count) --- */
	telemetry_init();
	telemetry_bump_boot_count();

	/* --- Modem init ----------------------------------------------- */
	err = nrf_modem_lib_init();
	if (err) {
		LOG_ERR("nrf_modem_lib_init failed: %d — rebooting in 30 s", err);
		k_msleep(30000);
		sys_reboot(SYS_REBOOT_COLD);
	}

	err = modem_info_init();
	if (err) {
		LOG_WRN("modem_info_init failed: %d (RSRP/RAT may be blank)", err);
	}

	/* --- LTE-M attach -------------------------------------------- */
	/* lte_lc_init() is auto-called by lte_lc_connect() in NCS 3.x —
	 * the standalone init function was removed. Just register the
	 * event handler then call connect(). */
	lte_lc_register_handler(lte_evt_handler);

	LOG_INF("requesting LTE-M attach...");
	err = lte_lc_connect();
	if (err) {
		LOG_ERR("lte_lc_connect failed: %d", err);
	}

	err = wait_for_lte(90);
	if (err) {
		LOG_ERR("LTE attach timed out after 90 s — rebooting");
		k_msleep(5000);
		sys_reboot(SYS_REBOOT_COLD);
	}

	/* --- Open the CoAP UDP socket -------------------------------- */
	err = coap_client_connect();
	if (err) {
		LOG_ERR("coap_client_connect failed: %d — will retry in loop", err);
	}

	/* --- Heartbeat loop ------------------------------------------ */
	uint32_t iter = 0;
	while (1) {
		iter++;
		LOG_INF("--- heartbeat #%u ---", iter);

		telemetry_t t;
		telemetry_collect(&t);
		LOG_INF("  uptime=%us  boot=%u  rst=%u",
			t.uptime_s, t.boot_count, t.reset_reason);
		LOG_INF("  battery: vbat=%dmV  ibat=%+dmA  ntc=%d°C",
			t.vbat_mV, t.ibat_mA, t.ntc_C);
		LOG_INF("  cellular: rat=%s  rsrp=%ddBm  modem=%d°C",
			t.rat[0] ? t.rat : "?", t.rsrp_dBm, t.modem_C);
		if (t.imu_ok) {
			LOG_INF("  imu: ax=%+dmg ay=%+dmg az=%+dmg  imu=%d°C",
				t.accel_x_mg, t.accel_y_mg, t.accel_z_mg, t.imu_C);
		} else {
			LOG_WRN("  imu: read failed");
		}

		uint8_t payload[MAX_PAYLOAD_BYTES];
		int n = telemetry_encode_cbor(&t, payload, sizeof(payload));
		if (n < 0) {
			LOG_ERR("CBOR encode failed: %d", n);
			k_msleep(FAIL_BACKOFF_MS);
			continue;
		}
		LOG_INF("  cbor payload %d bytes", n);

		led_blip();   /* visible "transmitting now" indicator */
		err = coap_client_post_heartbeat(payload, (size_t)n);
		if (err) {
			LOG_WRN("heartbeat #%u FAILED (err %d) — backoff %d ms",
				iter, err, FAIL_BACKOFF_MS);
			k_msleep(FAIL_BACKOFF_MS);
			continue;
		}
		LOG_INF("heartbeat #%u OK — sleeping %d s",
			iter, COAP_HEARTBEAT_INTERVAL_S);

		k_msleep(COAP_HEARTBEAT_INTERVAL_S * 1000);
	}

	return 0;
}
```

## src/coap_client.c
```c
/*
 * Plain (non-DTLS) CoAP POST client for the heartbeat.
 *
 * Uses the Zephyr CoAP library at the low-level packet API. (We're
 * not using coap_client_req in v1 because we want explicit control
 * over the UDP socket for fast PSM-aware reconnect logic.)
 *
 * Flow per heartbeat:
 *   1. If socket is closed, resolve DNS + connect
 *   2. Build a CON POST with path = "hb" and CBOR payload
 *   3. Send via sendto()
 *   4. recvfrom() with timeout; parse response code
 *   5. Return 0 on a 2.xx response, negative otherwise
 *
 * The modem PSM behaviour means socket DURING idle is typically OK —
 * the modem keeps its EPS bearer attached and we just sit. If the
 * tower drops us, the next sendto() returns an error and the caller
 * is expected to reconnect.
 */

#include "coap_client.h"
#include "server_config.h"

#include <zephyr/kernel.h>
#include <zephyr/logging/log.h>
#include <zephyr/net/coap.h>
#include <zephyr/net/socket.h>

#include <string.h>
#include <errno.h>
#include <stdlib.h>

LOG_MODULE_REGISTER(coap_client, LOG_LEVEL_INF);

#define COAP_VERSION       1
#define COAP_TOKEN_LEN     4
#define MAX_COAP_MSG_LEN   512

static int sock = -1;
static struct sockaddr_storage server_addr;

static int resolve_and_setup_address(void)
{
	struct addrinfo hints = {
		.ai_family   = AF_INET,
		.ai_socktype = SOCK_DGRAM,
	};
	struct addrinfo *res;

	int err = getaddrinfo(COAP_SERVER_HOST, NULL, &hints, &res);
	if (err) {
		LOG_ERR("getaddrinfo(%s) failed: %d", COAP_SERVER_HOST, err);
		return -EHOSTUNREACH;
	}

	struct sockaddr_in *server = (struct sockaddr_in *)&server_addr;
	server->sin_family = AF_INET;
	server->sin_port   = htons(COAP_SERVER_PORT);
	memcpy(&server->sin_addr,
	       &((struct sockaddr_in *)res->ai_addr)->sin_addr,
	       sizeof(server->sin_addr));

	char ip_str[INET_ADDRSTRLEN];
	inet_ntop(AF_INET, &server->sin_addr, ip_str, sizeof(ip_str));
	LOG_INF("resolved %s -> %s:%d",
		COAP_SERVER_HOST, ip_str, COAP_SERVER_PORT);

	freeaddrinfo(res);
	return 0;
}

int coap_client_connect(void)
{
	if (sock >= 0) {
		return 0;     /* already connected */
	}

	int err = resolve_and_setup_address();
	if (err) {
		return err;
	}

	sock = socket(AF_INET, SOCK_DGRAM, IPPROTO_UDP);
	if (sock < 0) {
		LOG_ERR("socket() failed: %d", errno);
		return -errno;
	}

	struct timeval tv = {
		.tv_sec  = COAP_REQUEST_TIMEOUT_MS / 1000,
		.tv_usec = (COAP_REQUEST_TIMEOUT_MS % 1000) * 1000,
	};
	if (setsockopt(sock, SOL_SOCKET, SO_RCVTIMEO, &tv, sizeof(tv)) < 0) {
		LOG_WRN("SO_RCVTIMEO setsockopt failed: %d", errno);
	}

	LOG_INF("coap_client UDP socket ready (fd=%d)", sock);
	return 0;
}

void coap_client_disconnect(void)
{
	if (sock >= 0) {
		close(sock);
		sock = -1;
		LOG_INF("coap_client socket closed");
	}
}

int coap_client_post_heartbeat(const uint8_t *payload, size_t len)
{
	if (sock < 0) {
		int err = coap_client_connect();
		if (err) {
			return err;
		}
	}

	/* --- Build CoAP CON POST -------------------------------------- */
	uint8_t coap_buf[MAX_COAP_MSG_LEN];
	struct coap_packet pkt;

	/* Random-ish token per request; helps server correlate. We don't
	 * need cryptographic randomness — uptime+counter is plenty for
	 * "uniquely identify which response goes with which request".
	 * Avoids pulling in CONFIG_ENTROPY_GENERATOR for sys_rand32_get. */
	static uint32_t token_seed;
	uint16_t msg_id = coap_next_id();
	uint8_t  token[COAP_TOKEN_LEN];
	uint32_t token_val = (uint32_t)k_uptime_get_32() ^ (++token_seed);
	memcpy(token, &token_val, sizeof(token));

	int r = coap_packet_init(&pkt, coap_buf, sizeof(coap_buf),
				 COAP_VERSION, COAP_TYPE_CON,
				 COAP_TOKEN_LEN, token,
				 COAP_METHOD_POST, msg_id);
	if (r < 0) {
		LOG_ERR("coap_packet_init failed: %d", r);
		return r;
	}

	r = coap_packet_append_option(&pkt, COAP_OPTION_URI_PATH,
				      COAP_HEARTBEAT_PATH,
				      strlen(COAP_HEARTBEAT_PATH));
	if (r < 0) {
		LOG_ERR("append URI_PATH failed: %d", r);
		return r;
	}

	uint8_t content_format = COAP_CONTENT_FORMAT_APP_CBOR;
	r = coap_packet_append_option(&pkt, COAP_OPTION_CONTENT_FORMAT,
				      &content_format, sizeof(content_format));
	if (r < 0) {
		LOG_ERR("append CONTENT_FORMAT failed: %d", r);
		return r;
	}

	r = coap_packet_append_payload_marker(&pkt);
	if (r < 0) {
		LOG_ERR("append payload marker failed: %d", r);
		return r;
	}

	r = coap_packet_append_payload(&pkt, payload, len);
	if (r < 0) {
		LOG_ERR("append payload failed: %d", r);
		return r;
	}

	/* --- Send ----------------------------------------------------- */
	ssize_t sent = sendto(sock, pkt.data, pkt.offset, 0,
			      (struct sockaddr *)&server_addr,
			      sizeof(struct sockaddr_in));
	if (sent < 0) {
		LOG_ERR("sendto failed: %d", errno);
		coap_client_disconnect();        /* force reconnect next time */
		return -errno;
	}
	LOG_INF("CoAP POST sent (%d bytes; payload %u)",
		(int)sent, (unsigned)len);

	/* --- Wait for ACK + response code ---------------------------- */
	uint8_t resp_buf[256];
	ssize_t got = recv(sock, resp_buf, sizeof(resp_buf), 0);
	if (got < 0) {
		LOG_ERR("recv failed: %d (timeout? server down?)", errno);
		coap_client_disconnect();
		return -errno;
	}

	struct coap_packet resp;
	r = coap_packet_parse(&resp, resp_buf, got, NULL, 0);
	if (r < 0) {
		LOG_ERR("coap_packet_parse failed: %d", r);
		return r;
	}

	/* CoAP response codes pack the class in the top 3 bits, detail in
	 * the bottom 5. The macro COAP_RESPONSE_CODE_CLASS doesn't exist
	 * in this NCS, so we just shift. Class 2 = success (2.01, 2.04, ...). */
	uint8_t code = coap_header_get_code(&resp);
	uint8_t cls  = (code >> 5) & 0x07;
	uint8_t det  = code & 0x1f;
	if (cls == 2) {
		LOG_INF("CoAP response code %u.%02u (OK)", cls, det);
		return 0;
	}
	LOG_WRN("CoAP response code %u.%02u (not 2.xx)", cls, det);
	return -EBADMSG;
}
```

## src/coap_client.h
```c
/*
 * Minimal CoAP client for the reliability heartbeat.
 *
 * One persistent UDP socket to the server; one POST per heartbeat
 * carrying CBOR. No DTLS in v1 (server is on a public VPS UDP port —
 * acceptable for an unencrypted heartbeat test, will upgrade later).
 */
#ifndef COAP_CLIENT_H
#define COAP_CLIENT_H

#include <stdint.h>
#include <stddef.h>

/* Resolve the server hostname, open the UDP socket. Idempotent: safe
 * to call again after the previous socket dropped. Returns 0 on
 * success, negative errno otherwise. */
int coap_client_connect(void);

/* Close the socket. Call before suspending the modem if we want to
 * fully tear down between heartbeats. (Optional; the modem PSM path
 * can keep the socket alive too — we try keep-alive first and fall
 * back to connect-each-time if that's flaky.) */
void coap_client_disconnect(void);

/* POST `payload`/`len` bytes (already CBOR-encoded) to the
 * heartbeat path on the server. Returns 0 on success (server returned
 * 2.xx), negative errno otherwise. */
int coap_client_post_heartbeat(const uint8_t *payload, size_t len);

#endif /* COAP_CLIENT_H */
```

## src/server_config.h
```c
/*
 * Server endpoint configuration for the reliability test.
 *
 * Edit these to point at YOUR VPS. The values below are placeholders.
 *
 * COAP_SERVER_HOST can be either:
 *   - a hostname (e.g. "heartbeat.palroc.com") — needs DNS to resolve
 *   - a literal IPv4 address (e.g. "203.0.113.42") — skips DNS
 *
 * Default CoAP UDP port is 5683.
 *
 * COAP_HEARTBEAT_PATH is the resource path the server listens on for
 * heartbeats; the server-side Python app maps requests on this path to
 * its CSV logger. /hb is short = fewer UDP bytes per heartbeat.
 *
 * COAP_HEARTBEAT_INTERVAL_S sets how often the device wakes up to send.
 * 300 s (5 min) is good for benchtop / fast failure detection; bump to
 * 900 s (15 min) for a low-power overnight run.
 */
#ifndef SERVER_CONFIG_H
#define SERVER_CONFIG_H

#define COAP_SERVER_HOST           "158.179.212.244"
#define COAP_SERVER_PORT           5683
#define COAP_HEARTBEAT_PATH        "hb"

#define COAP_HEARTBEAT_INTERVAL_S  300   /* 5 minutes */

/* Per-transfer CoAP socket timeout (the modem can stall briefly on
 * a weak link). 30 s is generous; bumping to 60 s costs nothing
 * because we're sleep-gated by the interval above. */
#define COAP_REQUEST_TIMEOUT_MS    30000

#endif /* SERVER_CONFIG_H */
```

## src/telemetry.c
```c
/*
 * Telemetry collection + CBOR encoding.
 *
 * See telemetry.h for what the heartbeat carries. The CBOR layout is a
 * single map keyed by short strings so the server-side decoder can use
 * any standard CBOR library (cbor2 in Python).
 *
 * Map keys (kept short for tiny LTE-M payloads):
 *   "id"   tstr     16-char hex chip ID
 *   "up"   uint     uptime seconds
 *   "boot" uint     boot count
 *   "vbat" int      VBAT in millivolts
 *   "ibat" int      IBAT in milliamps (signed; + = charging)
 *   "ntc"  int      battery NTC temperature in °C
 *   "rsrp" int      RSRP in dBm (negative)
 *   "rat"  tstr     "LTE-M" / "NB-IoT" / ""
 *   "mC"   int      modem die temperature in °C
 *   "ax"   int      accel X, milli-g (gravity ≈ 1000)
 *   "ay"   int      accel Y, milli-g
 *   "az"   int      accel Z, milli-g
 *   "iC"   int      IMU die temperature in °C
 *   "iok"  uint     1 = IMU read succeeded, 0 = failed
 *   "rst"  uint     reset reason (compact enum byte)
 *   "fw"   tstr     firmware version short string
 *
 * 16 keys × ~10-12 bytes average → ~160-190 bytes CBOR. Plus CoAP
 * header + UDP/IP overhead ~ 230-260 bytes per heartbeat. Still
 * well under the LTE-M IP MTU of 1280.
 */

#include "telemetry.h"

#include <zephyr/kernel.h>
#include <zephyr/device.h>
#include <zephyr/drivers/hwinfo.h>
#include <zephyr/drivers/sensor.h>
#include <zephyr/drivers/i2c.h>
#include <zephyr/sys/reboot.h>
#include <zephyr/logging/log.h>

#include <zcbor_encode.h>

#include <modem/modem_info.h>
#include <modem/lte_lc.h>

#include <string.h>
#include <stdio.h>
#include <stdlib.h>

LOG_MODULE_REGISTER(telemetry, LOG_LEVEL_INF);

/* Persistent boot counter — kept in a Zephyr `__noinit` RAM area for
 * simplicity in v1 (survives soft resets but NOT power loss). For
 * persistent-across-power-cycles we'd use NVS or settings; deferred.
 * The CSV server log records its own server-side count anyway. */
static __noinit uint32_t persistent_boot_count;
static __noinit uint32_t persistent_boot_count_check;

#define BOOT_COUNT_MAGIC  0xCAFEFACEU

#define FW_VERSION_STR    "rel-test-0.1.0"

static char  s_chip_id[17];
static uint8_t s_reset_reason;

static void compute_chip_id(void)
{
	uint8_t id[8] = { 0 };
	ssize_t got = hwinfo_get_device_id(id, sizeof(id));
	if (got <= 0) {
		strncpy(s_chip_id, "unknown000000000", sizeof(s_chip_id));
		return;
	}
	/* Pad / clip to 8 bytes. */
	size_t n = (got > 8) ? 8 : (size_t)got;
	for (size_t i = 0; i < n; i++) {
		snprintf(&s_chip_id[i * 2], 3, "%02x", id[i]);
	}
	s_chip_id[16] = '\0';
}

static uint8_t fetch_reset_reason(void)
{
	uint32_t cause = 0;
	(void)hwinfo_get_reset_cause(&cause);
	(void)hwinfo_clear_reset_cause();
	/* The hwinfo cause is a bitmask, but we only need a compact single-
	 * byte enum for telemetry. Map by priority: power-on > brown-out >
	 * pin > soft > watchdog > everything else. */
	if (cause & RESET_POR)        return 1;
	if (cause & RESET_BROWNOUT)   return 2;
	if (cause & RESET_PIN)        return 3;
	if (cause & RESET_SOFTWARE)   return 4;
	if (cause & RESET_WATCHDOG)   return 5;
	if (cause & RESET_LOW_POWER_WAKE) return 6;
	if (cause)                    return 7;   /* "other" */
	return 0;                                   /* unknown */
}

void telemetry_init(void)
{
	compute_chip_id();
	s_reset_reason = fetch_reset_reason();

	LOG_INF("telemetry: chip_id=%s reset_reason=%u fw=%s",
		s_chip_id, s_reset_reason, FW_VERSION_STR);
}

void telemetry_bump_boot_count(void)
{
	if (persistent_boot_count_check != BOOT_COUNT_MAGIC) {
		persistent_boot_count = 0;
		persistent_boot_count_check = BOOT_COUNT_MAGIC;
	}
	persistent_boot_count++;
	LOG_INF("telemetry: boot_count=%u (this session)", persistent_boot_count);
}

/* nPM1300 charger device — see board's common.dtsi for the node. */
static const struct device *const charger =
	DEVICE_DT_GET_OR_NULL(DT_NODELABEL(npm1300_charger));

/* Read VBAT, IBAT, NTC from the nPM1300 charger sensor. On error
 * leaves the destination fields at 0 and logs once. */
static void read_npm1300(telemetry_t *t)
{
	if (!charger) {
		return;   /* DT didn't declare the node */
	}
	if (!device_is_ready(charger)) {
		LOG_WRN("nPM1300 charger not ready (i2c not up yet?)");
		return;
	}

	int err = sensor_sample_fetch(charger);
	if (err) {
		LOG_WRN("nPM1300 sample_fetch failed: %d", err);
		return;
	}

	struct sensor_value v;

	if (sensor_channel_get(charger, SENSOR_CHAN_GAUGE_VOLTAGE, &v) == 0) {
		/* val1=volts, val2=micro-volts. Convert to mV. */
		t->vbat_mV = (int16_t)(v.val1 * 1000 + v.val2 / 1000);
	}

	if (sensor_channel_get(charger, SENSOR_CHAN_GAUGE_AVG_CURRENT, &v) == 0) {
		/* val1=amps, val2=micro-amps. Convert to mA. Sign is
		 * preserved by the driver (negative = discharge). */
		t->ibat_mA = (int16_t)(v.val1 * 1000 + v.val2 / 1000);
	}

	if (sensor_channel_get(charger, SENSOR_CHAN_GAUGE_TEMP, &v) == 0) {
		/* val1=°C (integer part), val2=micro-degrees. We only
		 * need integer °C. */
		t->ntc_C = (int8_t)v.val1;
	}
}

/* --- LSM6DSO IMU on i2c2 (EVT2 only — EVT1 had it on SPI3) ----------
 *
 * We hit the device with raw I²C register reads, same pattern as the
 * bring-up i2c_probe.c. No Zephyr sensor-driver dependency — pulling
 * in CONFIG_SENSOR_LSM6DSO would add a non-trivial amount of code for
 * what's effectively four register reads. Cheaper to talk raw.
 *
 * Quick map of the registers we touch:
 *   0x0F WHO_AM_I    -> 0x6C
 *   0x10 CTRL1_XL    -> 0x40 = 104 Hz, ±2 g (set once if not running)
 *   0x20 CTRL3_C     -> enable BDU (block-data-update) to prevent
 *                       tearing between the two bytes of each axis
 *   0x20 OUT_TEMP_L  -> 16-bit signed temp, LSB = 1/256 °C, offset 25°C
 *   0x28 OUTX_L_A    -> 6 bytes of XYZ accel, LSB = 0.061 mg
 *
 * No reset / sleep handling — the chip is already powered, and once
 * CTRL1_XL is set it stays in continuous-conversion mode across our
 * 5-minute heartbeat interval. */
#define LSM6DSO_I2C_ADDR        0x6a
#define LSM6DSO_REG_WHO_AM_I    0x0F
#define LSM6DSO_WHO_AM_I_VAL    0x6C
#define LSM6DSO_REG_CTRL1_XL    0x10
#define LSM6DSO_CTRL1_XL_104_2G 0x40
#define LSM6DSO_REG_CTRL3_C     0x12
#define LSM6DSO_CTRL3_C_BDU     0x40   /* BDU=1, IF_INC=0 (we set IF_INC separately on burst reads) */
#define LSM6DSO_REG_OUT_TEMP_L  0x20
#define LSM6DSO_REG_OUTX_L_A    0x28

/* 0.061 mg per LSB at ±2 g full scale (LSM6DSO datasheet §4.1). */
#define LSM6DSO_ACCEL_LSB_MG_X1000  61   /* milli-g × 1000, so mg = (raw * 61) / 1000 */

static bool imu_configured;

static const struct device *const i2c2 =
	DEVICE_DT_GET_OR_NULL(DT_NODELABEL(i2c2));

static int imu_ensure_configured(void)
{
	if (imu_configured) {
		return 0;
	}
	if (!i2c2 || !device_is_ready(i2c2)) {
		return -ENODEV;
	}

	uint8_t who = 0;
	int ret = i2c_reg_read_byte(i2c2, LSM6DSO_I2C_ADDR,
				    LSM6DSO_REG_WHO_AM_I, &who);
	if (ret || who != LSM6DSO_WHO_AM_I_VAL) {
		LOG_WRN("LSM6DSO WHO_AM_I read failed: ret=%d val=0x%02x",
			ret, who);
		return ret ? ret : -ENODEV;
	}

	/* 104 Hz / ±2 g — same setup the bring-up used. Block-data-update
	 * so a fast caller can't read a half-updated 16-bit sample. */
	(void)i2c_reg_write_byte(i2c2, LSM6DSO_I2C_ADDR,
				 LSM6DSO_REG_CTRL1_XL,
				 LSM6DSO_CTRL1_XL_104_2G);
	(void)i2c_reg_write_byte(i2c2, LSM6DSO_I2C_ADDR,
				 LSM6DSO_REG_CTRL3_C,
				 LSM6DSO_CTRL3_C_BDU | 0x04 /*IF_INC=1*/);

	imu_configured = true;
	LOG_INF("LSM6DSO configured (104 Hz, ±2 g, BDU)");
	return 0;
}

static void read_imu(telemetry_t *t)
{
	if (imu_ensure_configured() != 0) {
		t->imu_ok = 0;
		return;
	}

	/* Accel XYZ: 6 bytes little-endian signed. With CTRL3_C.IF_INC=1
	 * we can burst-read across the auto-incrementing register window. */
	uint8_t buf[6];
	int ret = i2c_burst_read(i2c2, LSM6DSO_I2C_ADDR,
				 LSM6DSO_REG_OUTX_L_A, buf, sizeof(buf));
	if (ret) {
		LOG_WRN("IMU accel burst-read failed: %d", ret);
		t->imu_ok = 0;
		return;
	}
	int16_t raw_x = (int16_t)(buf[0] | (buf[1] << 8));
	int16_t raw_y = (int16_t)(buf[2] | (buf[3] << 8));
	int16_t raw_z = (int16_t)(buf[4] | (buf[5] << 8));

	/* Convert raw LSB to milli-g. 0.061 mg/LSB → multiply by 61, /1000.
	 * Worst-case raw value ±32768 × 61 = ±2.0e6, fits in int32_t. */
	t->accel_x_mg = (int16_t)(((int32_t)raw_x * LSM6DSO_ACCEL_LSB_MG_X1000) / 1000);
	t->accel_y_mg = (int16_t)(((int32_t)raw_y * LSM6DSO_ACCEL_LSB_MG_X1000) / 1000);
	t->accel_z_mg = (int16_t)(((int32_t)raw_z * LSM6DSO_ACCEL_LSB_MG_X1000) / 1000);

	/* IMU die temp: 16-bit signed, LSB = 1/256 °C, zero-offset 25°C
	 * (LSM6DSO datasheet §4.3). So °C = 25 + raw/256. */
	uint8_t tbuf[2];
	ret = i2c_burst_read(i2c2, LSM6DSO_I2C_ADDR,
			     LSM6DSO_REG_OUT_TEMP_L, tbuf, sizeof(tbuf));
	if (ret == 0) {
		int16_t raw_t = (int16_t)(tbuf[0] | (tbuf[1] << 8));
		t->imu_C = (int8_t)(25 + (raw_t / 256));
	}

	t->imu_ok = 1;
}

/* Read cellular RAT + RSRP + modem die temperature. Robust to the
 * modem not being attached yet (just leaves fields zeroed). */
static void read_cellular(telemetry_t *t)
{
	/* --- RAT via lte_lc API (more reliable than MODEM_INFO_LTE_MODE
	 * which can return stale data right after attach) -------------- */
	enum lte_lc_lte_mode mode = LTE_LC_LTE_MODE_NONE;
	int err = lte_lc_lte_mode_get(&mode);
	if (err == 0) {
		switch (mode) {
		case LTE_LC_LTE_MODE_LTEM:
			strncpy(t->rat, "LTE-M", sizeof(t->rat) - 1);
			break;
		case LTE_LC_LTE_MODE_NBIOT:
			strncpy(t->rat, "NB-IoT", sizeof(t->rat) - 1);
			break;
		default:
			t->rat[0] = '\0';
			break;
		}
	}

	/* --- RSRP: modem_info returns the RAW INDEX (0..97), not dBm.
	 * Conversion per 3GPP TS 36.133 §9.1.4:
	 *     RSRP[dBm] = index - 140
	 * So index 39 → -101 dBm, index 97 → -43 dBm. Index 255 means
	 * "not measured". ----------------------------------------------- */
	char buf[32] = { 0 };
	int len = modem_info_string_get(MODEM_INFO_RSRP, buf, sizeof(buf));
	if (len > 0) {
		int idx = atoi(buf);
		if (idx > 0 && idx < 255) {
			t->rsrp_dBm = (int16_t)(idx - 140);
		}
	}

	/* --- Modem die temperature via AT+CTEMP / modem_info ---------- */
	len = modem_info_string_get(MODEM_INFO_TEMP, buf, sizeof(buf));
	if (len > 0) {
		t->modem_C = (int8_t)atoi(buf);
	}
}

void telemetry_collect(telemetry_t *t)
{
	memset(t, 0, sizeof(*t));

	strncpy(t->chip_id, s_chip_id, sizeof(t->chip_id));
	t->uptime_s    = k_uptime_get() / 1000;
	t->boot_count  = persistent_boot_count;
	t->reset_reason = s_reset_reason;
	strncpy(t->fw_version, FW_VERSION_STR, sizeof(t->fw_version) - 1);

	read_npm1300(t);
	read_cellular(t);
	read_imu(t);
}

int telemetry_encode_cbor(const telemetry_t *t, uint8_t *buf, size_t buf_len)
{
	ZCBOR_STATE_E(state, 1 /*map*/, buf, buf_len, 16);

	bool ok = true;
	ok = ok && zcbor_map_start_encode(state, 16);

	ok = ok && zcbor_tstr_put_lit(state, "id");
	ok = ok && zcbor_tstr_put_term(state, t->chip_id, sizeof(t->chip_id));

	ok = ok && zcbor_tstr_put_lit(state, "up");
	ok = ok && zcbor_uint32_put(state, t->uptime_s);

	ok = ok && zcbor_tstr_put_lit(state, "boot");
	ok = ok && zcbor_uint32_put(state, t->boot_count);

	ok = ok && zcbor_tstr_put_lit(state, "vbat");
	ok = ok && zcbor_int32_put(state, t->vbat_mV);

	ok = ok && zcbor_tstr_put_lit(state, "ibat");
	ok = ok && zcbor_int32_put(state, t->ibat_mA);

	ok = ok && zcbor_tstr_put_lit(state, "ntc");
	ok = ok && zcbor_int32_put(state, t->ntc_C);

	ok = ok && zcbor_tstr_put_lit(state, "rsrp");
	ok = ok && zcbor_int32_put(state, t->rsrp_dBm);

	ok = ok && zcbor_tstr_put_lit(state, "rat");
	ok = ok && zcbor_tstr_put_term(state, t->rat, sizeof(t->rat));

	ok = ok && zcbor_tstr_put_lit(state, "mC");
	ok = ok && zcbor_int32_put(state, t->modem_C);

	ok = ok && zcbor_tstr_put_lit(state, "ax");
	ok = ok && zcbor_int32_put(state, t->accel_x_mg);

	ok = ok && zcbor_tstr_put_lit(state, "ay");
	ok = ok && zcbor_int32_put(state, t->accel_y_mg);

	ok = ok && zcbor_tstr_put_lit(state, "az");
	ok = ok && zcbor_int32_put(state, t->accel_z_mg);

	ok = ok && zcbor_tstr_put_lit(state, "iC");
	ok = ok && zcbor_int32_put(state, t->imu_C);

	ok = ok && zcbor_tstr_put_lit(state, "iok");
	ok = ok && zcbor_uint32_put(state, t->imu_ok);

	ok = ok && zcbor_tstr_put_lit(state, "rst");
	ok = ok && zcbor_uint32_put(state, t->reset_reason);

	ok = ok && zcbor_tstr_put_lit(state, "fw");
	ok = ok && zcbor_tstr_put_term(state, t->fw_version, sizeof(t->fw_version));

	ok = ok && zcbor_map_end_encode(state, 16);

	if (!ok) {
		LOG_ERR("CBOR encode failed");
		return -EINVAL;
	}
	return (int)(state->payload - buf);
}
```

## src/telemetry.h
```c
/*
 * Telemetry collection + CBOR encoding for the reliability heartbeat.
 *
 * One struct describes everything we want to send. telemetry_collect()
 * fills it in; telemetry_encode_cbor() serialises it to a CBOR map
 * the server can parse.
 *
 * Adding a field: add it to telemetry_t, fill it in telemetry_collect(),
 * encode it in telemetry_encode_cbor(). The server side is decoded by
 * CBOR-map key so order doesn't matter.
 */
#ifndef TELEMETRY_H
#define TELEMETRY_H

#include <stdint.h>
#include <stddef.h>

typedef struct {
	char     chip_id[17];    /* 8-byte hwinfo ID rendered as 16 hex + null */
	uint32_t uptime_s;       /* seconds since boot */
	uint32_t boot_count;     /* monotonic across resets (RAM noinit in v1) */

	/* --- battery / power (nPM1300) --- */
	int16_t  vbat_mV;        /* battery voltage in mV */
	int16_t  ibat_mA;        /* battery current in mA, signed:
	                          *   positive = charging (solar > load)
	                          *   negative = discharging */
	int8_t   ntc_C;          /* battery NTC temperature in °C */

	/* --- cellular --- */
	int16_t  rsrp_dBm;       /* serving-cell RSRP in dBm (negative) */
	char     rat[8];         /* "LTE-M" | "NB-IoT" | "" */
	int8_t   modem_C;        /* modem die temperature in °C */

	/* --- IMU (LSM6DSO over i2c2) --- */
	int16_t  accel_x_mg;     /* accel X, milli-g (gravity ≈ 1000) */
	int16_t  accel_y_mg;
	int16_t  accel_z_mg;
	int8_t   imu_C;          /* IMU die temperature in °C */
	uint8_t  imu_ok;         /* 1 = WHO_AM_I matched, 0 = not present / I²C error */

	/* --- system / debug --- */
	uint8_t  reset_reason;   /* hwinfo-mapped enum (compact byte) */
	char     fw_version[16]; /* short version string */
} telemetry_t;

/* Render hwinfo device-id into chip_id (16 hex chars + null). Idempotent. */
void telemetry_init(void);

/* Increment the boot counter and persist it. Call once at boot. */
void telemetry_bump_boot_count(void);

/* Collect all current telemetry into *t. */
void telemetry_collect(telemetry_t *t);

/* CBOR-encode *t into `buf` (capacity `buf_len`). Returns number of
 * bytes written, or negative on error. */
int  telemetry_encode_cbor(const telemetry_t *t, uint8_t *buf, size_t buf_len);

#endif /* TELEMETRY_H */
```
