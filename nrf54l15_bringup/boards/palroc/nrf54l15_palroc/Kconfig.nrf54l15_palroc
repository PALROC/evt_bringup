## nrf54l15_bringup/boards/palroc/nrf54l15_palroc/Kconfig.nrf54l15_palroc
```kconfig
# Copyright (c) 2024 Nordic Semiconductor ASA
# SPDX-License-Identifier: Apache-2.0

config BOARD_NRF54L15_PALROC
	select SOC_NRF54L15_CPUAPP if BOARD_NRF54L15_PALROC_NRF54L15_CPUAPP
```

## nrf54l15_bringup/boards/palroc/nrf54l15_palroc/board.yml
```yaml
board:
  name: nrf54l15_palroc
  full_name: nRF54L15 palroc
  vendor: palroc
  socs:
    - name: nrf54l15
runners:
  run_once:
    '--recover':
      - runners:
          - nrfjprog
          - nrfutil
        run: first
        groups:
          - boards:
              - nrf54l15_palroc/nrf54l15/cpuapp
    '--erase':
      - runners:
          - nrfjprog
          - jlink
          - nrfutil
        run: first
        groups:
          - boards:
              - nrf54l15_palroc/nrf54l15/cpuapp
    '--reset':
      - runners:
          - nrfjprog
          - jlink
          - nrfutil
        run: last
        groups:
          - boards:
              - nrf54l15_palroc/nrf54l15/cpuapp
```

## nrf54l15_bringup/boards/palroc/nrf54l15_palroc_complete/Kconfig.nrf54l15_palroc_complete
```kconfig
# Copyright (c) 2025 Generated by Nordic Semiconductor Pin Planner
# SPDX-License-Identifier: Apache-2.0

config BOARD_NRF54L15_PALROC_COMPLETE
	select SOC_NRF54L15_CPUAPP if BOARD_NRF54L15_PALROC_COMPLETE_NRF54L15_CPUAPP || BOARD_NRF54L15_PALROC_COMPLETE_NRF54L15_CPUAPP_NS
	select SOC_NRF54L15_CPUFLPR if BOARD_NRF54L15_PALROC_COMPLETE_NRF54L15_CPUFLPR || \
					    BOARD_NRF54L15_PALROC_COMPLETE_NRF54L15_CPUFLPR_XIP
```

## nrf54l15_bringup/boards/palroc/nrf54l15_palroc_complete/board.yml
```yaml
board:
  name: nrf54l15_palroc_complete
  full_name: nrf54l15_palroc_generated_bypinplanner
  vendor: palroc
  socs:
    - name: nrf54l15
      variants:
        - name: xip
          cpucluster: cpuflpr
        - name: ns
          cpucluster: cpuapp
runners:
  run_once:
    '--recover':
      - runners:
          - nrfjprog
          - nrfutil
        run: first
        groups:
          - boards:
              - nrf54l15_palroc_complete/nrf54l15/cpuapp
              - nrf54l15_palroc_complete/nrf54l15/cpuapp/ns
              - nrf54l15_palroc_complete/nrf54l15/cpuflpr
              - nrf54l15_palroc_complete/nrf54l15/cpuflpr/xip
    '--erase':
      - runners:
          - nrfjprog
          - jlink
          - nrfutil
        run: first
        groups:
          - boards:
              - nrf54l15_palroc_complete/nrf54l15/cpuapp
              - nrf54l15_palroc_complete/nrf54l15/cpuapp/ns
              - nrf54l15_palroc_complete/nrf54l15/cpuflpr
              - nrf54l15_palroc_complete/nrf54l15/cpuflpr/xip
    '--reset':
      - runners:
          - nrfjprog
          - jlink
          - nrfutil
        run: last
        groups:
          - boards:
              - nrf54l15_palroc_complete/nrf54l15/cpuapp
              - nrf54l15_palroc_complete/nrf54l15/cpuapp/ns
              - nrf54l15_palroc_complete/nrf54l15/cpuflpr
              - nrf54l15_palroc_complete/nrf54l15/cpuflpr/xip
```

## nrf54l15_bringup/boards/palroc/nrf54l15_palroc_complete/nrf54l15_palroc_complete_nrf54l15_cpuapp_defconfig
```kconfig
# Copyright (c) 2025 Generated by Nordic Semiconductor Pin Planner
# SPDX-License-Identifier: Apache-2.0

# Enable GPIO
CONFIG_GPIO=y

# Enable MPU
CONFIG_ARM_MPU=y

# Use RC oscillator for low-frequency clock
CONFIG_CLOCK_CONTROL_NRF_K32SRC_RC=y
```

## nrf54l15_bringup/boards/palroc/nrf54l15_palroc_complete/nrf54l15_palroc_complete_nrf54l15_cpuapp_ns_defconfig
```kconfig
# Copyright (c) 2025 Generated by Nordic Semiconductor Pin Planner
# SPDX-License-Identifier: Apache-2.0

# Enable MPU
CONFIG_ARM_MPU=y
CONFIG_NULL_POINTER_EXCEPTION_DETECTION_NONE=y

# Enable TrustZone-M
CONFIG_ARM_TRUSTZONE_M=y

# This Board implies building Non-Secure firmware
CONFIG_TRUSTED_EXECUTION_NONSECURE=y

# Use devicetree code partition for TF-M
CONFIG_USE_DT_CODE_PARTITION=y

# Enable GPIO
CONFIG_GPIO=y

# Don't enable the cache in the non-secure image as it is a
# secure-only peripheral on 54l
CONFIG_CACHE_MANAGEMENT=n
CONFIG_EXTERNAL_CACHE=n

# Start SYSCOUNTER on driver init
CONFIG_NRF_GRTC_START_SYSCOUNTER=y

# Disable TFM BL2 since it is not supported
CONFIG_TFM_BL2=n

# RTT-only boards do not expose a secure UART for TF-M logging
CONFIG_TFM_LOG_LEVEL_SILENCE=y
CONFIG_TFM_SECURE_UART=n

# The oscillators are configured as secure and cannot be configured
# from the non secure application directly. This needs to be set
# otherwise nrfx will try to configure them, resulting in a bus
# fault.
CONFIG_NRF_SKIP_CLOCK_CONFIG=y
```

## nrf54l15_bringup/boards/palroc/nrf54l15_palroc_complete/nrf54l15_palroc_complete_nrf54l15_cpuflpr_defconfig
```kconfig
# Copyright (c) 2025 Generated by Nordic Semiconductor Pin Planner
# SPDX-License-Identifier: Apache-2.0

# Enable GPIO
CONFIG_GPIO=y

CONFIG_USE_DT_CODE_PARTITION=y

# Execute from SRAM
CONFIG_XIP=n
```

## nrf54l15_bringup/boards/palroc/nrf54l15_palroc_complete/nrf54l15_palroc_complete_nrf54l15_cpuflpr_xip_defconfig
```kconfig
# Copyright (c) 2025 Generated by Nordic Semiconductor Pin Planner
# SPDX-License-Identifier: Apache-2.0

# Enable GPIO
CONFIG_GPIO=y

# Execute from RRAM
CONFIG_XIP=y
```

## nrf9151_bringup/boards/palroc/nrf9151dk/Kconfig.defconfig
```kconfig
# Palroc nRF9151 board configuration

# SPDX-License-Identifier: Apache-2.0

config HW_STACK_PROTECTION
	default ARCH_HAS_STACK_PROTECTION

if BOARD_NRF9151_PALROC_NRF9151 || BOARD_NRF9151_PALROC_NRF9151_NS

config BOARD_NRF9151_PALROC
	select USE_DT_CODE_PARTITION if BOARD_NRF9151_PALROC_NRF9151_NS

config BT_HCI_VS
	default y if BT

endif # BOARD_NRF9151_PALROC_NRF9151 || BOARD_NRF9151_PALROC_NRF9151_NS
```

## nrf9151_bringup/boards/palroc/nrf9151dk/Kconfig.nrf9151_palroc
```kconfig
# Palroc nRF9151 board configuration

# SPDX-License-Identifier: Apache-2.0

config BOARD_NRF9151_PALROC
	select SOC_NRF9151_LACA
```

## nrf9151_bringup/boards/palroc/nrf9151dk/board.yml
```yaml
board:
  name: nrf9151_palroc
  full_name: nRF9151 DK Bringup
  vendor: palroc
  socs:
  - name: nrf9151
    variants:
    - name: 'ns'
```
